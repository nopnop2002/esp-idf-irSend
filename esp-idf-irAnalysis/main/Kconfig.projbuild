## esp-idf-irAnalysis/main/Kconfig.projbuild
```kconfig
menu "Application Configuration"

    config EXAMPLE_RMT_RX_GPIO
        int "RMT RX GPIO"
        default 19
        help
            Set the GPIO number used for receiving the RMT signal.


    config EXAMPLE_RMT_RX_CHANNEL
        int "RMT RX Channel Number"
        default 4 if IDF_TARGET_ESP32S3
        default 2
        help
            Set the RMT RX channel number.
endmenu
```
